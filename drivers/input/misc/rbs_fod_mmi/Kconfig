## drivers/input/touchscreen/goodix_berlin_mmi/Kconfig
```kconfig
#
# Goodix touchscreen driver configuration
#
menuconfig TOUCHSCREEN_GOODIX_BRL_MMI
	tristate "Goodix berlin touchscreen"
	help
	  Say Y here if you have a Goodix berlin series touch controller
	  to your system.

	  If build module, say M.
	  If unsure, say N.

if TOUCHSCREEN_GOODIX_BRL_MMI

config TOUCHSCREEN_GOODIX_BRL_MMI_SPI
	bool "support SPI bus connection"
	help
		Say Y here if the touchscreen is connected via SPI bus.

config GTP_FOD
	bool "GTP FOD"

config GTP_LIMIT_USE_SUPPLIER
	bool "GTP Limit Use Supplier"

config GTP_ENABLE_PM_QOS
	bool "GTP enable PM QOS"

config GOODIX_ESD_ENABLE
	bool "Goodix ESD enable"

config GTP_DDA_STYLUS
	bool "GTP DDA Stylus"

config GOODIX_GESTURES_0X80
	bool "Goodix gestures 0x80"

choice
	prompt "Goodix report rate"
	default GOODIX_REPORT_RATE_NONE

config GOODIX_REPORT_RATE_NONE
	bool "Goodix report rate none"

config GOODIX_REPORT_RATE_0
	bool "Goodix report rate 0"

config GOODIX_REPORT_RATE_1
	bool "Goodix report rate 1"

config GOODIX_REPORT_RATE_2
	bool "Goodix report rate 2"

endchoice

endif
```

## drivers/input/touchscreen/touchscreen_mmi/Kconfig
```kconfig
config PANEL_NOTIFICATIONS
	bool "Panel Notifications"

config DRM_DYNAMIC_REFRESH_RATE
	bool "DRM Dynamic Refresh Rate"

config TOUCHCLASS_MMI_DEBUG_INFO
	bool "MMI Debug Info"

config TOUCHCLASS_MMI_GESTURE_POISON_EVENT
	bool "MMI Gesture Poison Event"

config TOUCHCLASS_MMI_MULTIWAY_UPDATE_FW
	bool "MMI Multiway Update FW"

config DRM_PANEL_NOTIFICATIONS
	bool "DRM Panel Notifications"

config DRM_PANEL_EVENT_NOTIFICATIONS
	bool "DRM Panel Event Notifications"

config BOARD_USES_DOUBLE_TAP_CTRL
	bool "Board uses Double Tap Control"

config INPUT_TOUCHSCREEN_MMI
	bool "Touchscreen MMI"
```

## drivers/power/Kconfig
```kconfig
# SPDX-License-Identifier: GPL-2.0-only
source "drivers/power/reset/Kconfig"
source "drivers/power/supply/Kconfig"
source "drivers/power/qpnp_adaptive_charge/Kconfig"
source "drivers/power/qti_glink_charger/Kconfig"
source "drivers/power/mmi_charger/Kconfig"
```

## drivers/power/mmi_charger/Kconfig
```kconfig
config USE_MMI_CHARGER
	bool "Use MMI Charger"

config MMI_RECHARGER_HAWAO_MODE
	bool "MMI Recharger HAWAO Mode"
```
