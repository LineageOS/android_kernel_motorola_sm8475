/dts-v1/;
/plugin/;

#include <dt-bindings/clock/qcom,gcc-waipio.h>
#include <dt-bindings/clock/qcom,camcc-waipio.h>
#include <dt-bindings/interconnect/qcom,waipio.h>
#include <dt-bindings/interrupt-controller/arm-gic.h>
#include <dt-bindings/regulator/qcom,rpmh-regulator-levels.h>

#include "waipio-camera-sensor-hiphi-common.dtsi"

#define HIPHI_RADIO_ROW 3

/ {
	model = "hiphi";
	compatible = "qcom,waipio", "qcom,waipiop", "moto,hiphi";
	qcom,msm-id = <457 0x10000>, <482 0x10000>, <457 0x20000>, <482 0x20000>;
	qcom,board-id = <0x47 0xA100>, <0x47 0xB100>, <(HIPHI_RADIO_ROW << 8 | 0x47) 0xB100>, <0x47 0xC200>, <(HIPHI_RADIO_ROW << 8 | 0x47) 0xC200>, <(HIPHI_RADIO_ROW << 8 | 0x47) 0xC300>;
};
