/dts-v1/;
/plugin/;

#include <dt-bindings/clock/qcom,gcc-waipio.h>
#include <dt-bindings/clock/qcom,camcc-waipio.h>
#include <dt-bindings/interconnect/qcom,waipio.h>
#include <dt-bindings/interrupt-controller/arm-gic.h>
#include <dt-bindings/regulator/qcom,rpmh-regulator-levels.h>

#include "waipio-camera-sensor-hiphic-evb1-common.dtsi"
/ {
	model = "hiphic";
	compatible = "qcom,waipio", "qcom,waipiop", "moto,hiphic";
	qcom,msm-id = <457 0x10000>, <482 0x10000>;
	qcom,board-id = <0x45 0x9100>;
};
