/dts-v1/;
/plugin/;

#include <dt-bindings/clock/qcom,gcc-diwali.h>
#include <dt-bindings/clock/qcom,camcc-diwali.h>
#include <dt-bindings/interconnect/qcom,diwali.h>
#include <dt-bindings/interrupt-controller/arm-gic.h>
#include <dt-bindings/regulator/qcom,rpmh-regulator-levels.h>

#include "diwali-camera-sensor-lynkco-common.dtsi"
/ {
	model = "lynkco";
	compatible = "qcom,diwali", "moto,lynkco";
	qcom,msm-id = <506 0x10000>, <547 0x10000>, <564 0x10000>;
	qcom,board-id = <0x41 0x9100>, <0x41 0xA100>;
};
