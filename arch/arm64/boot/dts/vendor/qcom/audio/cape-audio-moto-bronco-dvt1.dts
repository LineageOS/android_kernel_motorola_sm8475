/dts-v1/;
/plugin/;

#include "cape-audio-moto-bronco-common.dtsi"

 / {
	model = "bronco";
	compatible = "qcom,cape-mtp", "qcom,cape", "qcom,mtp", "moto,bronco";
	qcom,msm-id = <530 0x10000>, <531 0x10000>, <540 0x10000>;
	qcom,board-id = <0x46 0xB100>, <0x46 0xB200>;
};

&waipio_snd {
		qcom,model = "waipio-mtp_hdr-snd-card";
};
