/dts-v1/;
/plugin/;

#include "waipio-audio-moto-hiphi-common.dtsi"
 / {
	model = "hiphic";
	compatible = "qcom,waipio", "moto,hiphic";
	qcom,msm-id = <457 0x10000>, <482 0x10000>, <457 0x20000>, <482 0x20000>;
	qcom,board-id = <0x45 0xB100>, <0x45 0xB2A0>, <0x45 0xC1D0>;
};
