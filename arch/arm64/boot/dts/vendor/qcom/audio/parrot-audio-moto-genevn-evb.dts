/dts-v1/;
/plugin/;

#include "parrot-audio-moto-genevn-common.dtsi"
/{
	model = "genevn";
	compatible = "qcom,parrot-qrd", "qcom,parrot", "qcom,qrd", "moto,genevn";
	qcom,msm-id = <537 0x10000>;
	qcom,board-id = <0x41 0x9000>, <0x41 0xB100>;
};

